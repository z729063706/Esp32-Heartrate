#ifndef DISPLAY_1306_H
#define DISPLAY_1306_H

#include <Wire.h>
#include <Adafruit_GFX.h>
#include <Adafruit_SSD1306.h>

#define SCREEN_WIDTH 128  // OLED宽度
#define SCREEN_HEIGHT 64  // OLED高度
#define OLED_RESET    -1  // Reset pin

int displayState = 0;

Adafruit_SSD1306 display(SCREEN_WIDTH, SCREEN_HEIGHT, &Wire, OLED_RESET);

// 心跳大图
static const unsigned char PROGMEM heart_bmp[] =
{ 0x01, 0xF0, 0x0F, 0x80, 0x06, 0x1C, 0x38, 0x60, 0x18, 0x06, 0x60, 0x18, 0x10, 0x01, 0x80, 0x08,
  0x20, 0x01, 0x80, 0x04, 0x40, 0x00, 0x00, 0x02, 0x40, 0x00, 0x00, 0x02, 0xC0, 0x00, 0x08, 0x03,
  0x80, 0x00, 0x08, 0x01, 0x80, 0x00, 0x18, 0x01, 0x80, 0x00, 0x1C, 0x01, 0x80, 0x00, 0x14, 0x00,
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  0x00, 0x08, 0x10, 0x00, 0x00, 0x06, 0x60, 0x00, 0x00, 0x03, 0xC0, 0x00, 0x00, 0x01, 0x80, 0x00
};

// 氧气图示
static const unsigned char PROGMEM O2_bmp[] = {
  0x00, 0x00, 0x00, 0x00, 0x00, 0x00, 0x00, 0xf0, 0x00, 0x3f, 0xc3, 0xf8, 0x00, 0xff, 0xf3, 0xfc,
  0x03, 0xff, 0xff, 0xfe, 0x07, 0xff, 0xff, 0xfe, 0x0f, 0xff, 0xff, 0xfe, 0x0f, 0xff, 0xff, 0x7e,
  0x1f, 0x80, 0xff, 0xfc, 0x1f, 0x00, 0x7f, 0xb8, 0x3e, 0x3e, 0x3f, 0xb0, 0x3e, 0x3f, 0x3f, 0xc0,
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  0x0f, 0xe0, 0x00, 0x00, 0x07, 0x80, 0x00, 0x00, 0x00, 0x00, 0x00, 0x00, 0x00, 0x00, 0x00, 0x00
};

void displayClear() {
  display.clearDisplay();
  display.display();
}

void displayInit() {
  display.begin(SSD1306_SWITCHCAPVCC, 0x3C); // Start the OLED display
  display.display();
  delay(2000); // Pause for 2 seconds
  displayClear();
  Serial.println("Display initialized");
}

void displayLogo() {
  display.clearDisplay();
  display.drawBitmap(0, 0, heart_bmp, 32, 32, WHITE);
  display.setTextSize(2);
  display.setTextColor(WHITE);
  display.setCursor(42, 10);
  display.drawBitmap(0, 35, O2_bmp, 32, 32, WHITE);
  display.display();
  displayState = 1;
}

void displaySpo2(float spo2) {
  if (displayState != 1) {
    displayLogo();
  }
  display.fillRect(42, 40, 70, 16, BLACK);
  display.setCursor(42, 40);
  String str = String(spo2) + "%";
  if (spo2 < 90) {
    str = "---- %";
  }
  display.print(str);
  display.display();
}

void displayHeart(int bpm) {
  if (displayState != 1) {
    displayLogo();
  }
  display.fillRect(42, 10, 70, 16, BLACK);
  display.setCursor(42, 10);
  display.print(String(bpm) + " BPM");
  display.display();
}

void displayNoFinger() {
  display.clearDisplay();
  display.setTextSize(2);
  display.setTextColor(WHITE);
  display.setCursor(30, 5);
  display.println("No");
  display.setCursor(30, 35);
  display.println("Finger!");
  display.display();
  displayState = 2;
}

#endif // DISPLAY_1306_H